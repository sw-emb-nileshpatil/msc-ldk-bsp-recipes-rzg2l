## conf/local.conf
```bitbake
# Machine configuration
MACHINE = "sm2s-rzg2ul"
SOC_FAMILY = "r9a07g043u"
PACKAGECONFIG_append_pn-qemu-system-native = " sdl"

# Add systemd configuration
DISTRO_FEATURES_append = " systemd"
VIRTUAL-RUNTIME_init_manager = "systemd"

# add the static lib to SDK toolchain
SDKIMAGE_FEATURES_append = " staticdev-pkgs dev-pkgs dbg-pkgs"

# Enable pam distro feature
DISTRO_FEATURES_append = " pam"

# Enable wayland and disable x11
DISTRO_FEATURES_append = " wayland"
DISTRO_FEATURES_remove = " x11"

# Select CIP Core packages
CIP_CORE = "1"

LICENSE_FLAGS_WHITELIST = " \
	commercial_gstreamer1.0-plugins-ugly commercial_mpeg2dec \
	commercial_gst-plugins-bad commercial_faad2 commercial_faac \
	commercial_gstreamer1.0-libav commercial_ffmpeg commercial_x264 \
"

# For meta-virtualization layer
DISTRO_FEATURES_append = "${@oe.utils.conditional('VIRTUALIZATION_CHECK', 'True', ' virtualization', '', d)}"

# Generate compressed "git2_" gz of all git packages in DL_DIR
BB_GENERATE_MIRROR_TARBALLS = "1"

# Generate compressed "gitshallow_" gz of all git packages in DL_DIR
BB_GENERATE_SHALLOW_TARBALLS = "1"

# Use "gitshallow_" instead of normal git files in DL_DIR
BB_GIT_SHALLOW = "1"
BB_GIT_SHALLOW_DEPTH = "1"

# LVGL Demos support.
# Default is disabled. Set 1 to enable.
INSTALL_RZG2_DEMOS = "0"

BB_NO_NETWORK = "0"

#Set QT_LAYER
QT_LAYER="True"
```

## meta/conf/layer.conf
```bitbake
# Copyright (C) 2021 AVNET Embedded, MSC Technologies GmbH

# We have a conf and classes directory, add to BBPATH
BBPATH .= ":${LAYERDIR}"

# We have a packages directory, add to BBFILES
BBFILES += "${LAYERDIR}/recipes-*/*/*.bb ${LAYERDIR}/recipes-*/*/*.bbappend"

BBFILE_COLLECTIONS += "bsp"
BBFILE_PATTERN_bsp := "^${LAYERDIR}/"
BBFILE_PRIORITY_bsp = "30"

# This should only be incremented on significant changes that will
# cause compatibility issues with other layers
LAYERVERSION_bsp = "1"

LAYERDEPENDS_bsp = "bsp"
LAYERSERIES_COMPAT_bsp = "gatesgarth hardknott"
#
BBFILES += "${@' '.join('${LAYERDIR}/dynamic-layers/%s/recipes*/*/*.bbappend' % layer \
               for layer in BBFILE_COLLECTIONS.split())}"
BBFILES += "${@' '.join('${LAYERDIR}/dynamic-layers/%s/recipes*/*/*.bb' % layer \
               for layer in BBFILE_COLLECTIONS.split())}"

# This is to support .bbappend files for recipes from meta-msc-ldk-lxqt and
# meta-msc-ldk-hwtests even when there is no msc-ldk-lxqt or msc-ldk-hwtests
# layer.
# Because of priority 1 it's .bb files will be overwritten by meta-msc-ldk-lxqt
# and meta-msc-ldk-hwtests respectively.
BBFILES += "${LAYERDIR}/.dummy-recipes-*/*/*.bb"
BBFILE_COLLECTIONS += "bsp-dummy-recipes"
BBFILE_PATTERN_bsp-dummy-recipes = "^${LAYERDIR}/.dummy-recipes-*"
BBFILE_PRIORITY_bsp-dummy-recipes = "1"
LAYERSERIES_COMPAT_bsp-dummy-recipes = "hardknott"
```

## meta/conf/machine/include/imx-preferred-env.inc
```bitbake
# Copyright (C) 2021 AVNET Embedded, MSC Technologies GmbH

include ../../meta-imx.git/meta-sdk/conf/distro/include/fsl-imx-preferred-env.inc
```

## meta/conf/machine/sm2s-am6254-k3r5.conf
```bitbake
# Copyright (C) 2022 AVNET Embedded

#@TYPE: Machine
#@NAME: AM62XX (R5F)
#@DESCRIPTION: Machine configuration for the TI AM62xx (R5F core)

#Derived from meta-ti/conf/machine/am62xx-evm-k3r5.conf

require ../../meta-ti.git/conf/machine/include/k3r5.inc

SYSFW_SOC = "am62x"
SYSFW_CONFIG = "evm"
SYSFW_SUFFIX = "gp"

UBOOT_MACHINE = "am62x_evm_r5_defconfig"
```

## meta/conf/machine/sm2s-am6254.conf
```bitbake
# Copyright (C) 2022 AVNET Embedded

#@TYPE: Machine
#@NAME: AM6254 based avnet custom board design
#@DESCRIPTION: Machine configuration for the Avnet based custom TI AM6254

#Derived from meta-ti/conf/machine/am62xx-evm.conf

require ../../meta-ti.git/conf/machine/include/am62xx.inc

MACHINE_FEATURES += "gpu"

KERNEL_DEVICETREE = " \
    ti/k3-am625-sk.dtb \
    ti/k3-am625-skeleton.dtb \
    ti/k3-am625-sk-lpmdemo.dtb \
    ti/k3-am625-sk-csi2-ov5640.dtbo \
"

UBOOT_MACHINE = "am62x_evm_a53_defconfig"
```

## meta/conf/machine/sm2s-imx8mm-qc.conf
```bitbake
# Copyright (C) 2020 AVNET Integrated, MSC Technologies GmbH
#@TYPE: Machine
#@NAME: MSC sm2s-imx8mm-qc module
#@SOC: i.MX8MM
#@DESCRIPTION: Machine configuration for sm2s-imx8mm-qc

MACHINEOVERRIDES =. "mx8:mx8m:mx8mm:"

require conf/machine/include/imx-base.inc
require conf/machine/include/arm/arch-arm64.inc

include sm2s-imx8mm.inc
```

## meta/conf/machine/sm2s-imx8mm.conf
```bitbake
# Copyright (C) 2021 AVNET Embedded, MSC Technologies GmbH
# @TYPE: Machine
# @NAME: sm2s-imx8mm module
# @SOC: i.MX8MM

include sm2s-imx8mm.inc
```

## meta/conf/machine/sm2s-imx8mm.inc
```bitbake
# Copyright (C) 2021 AVNET Embedded, MSC Technologies GmbH
# @TYPE: Machine
# @NAME: MSC sm2s-imx8mm
# @SOC: i.MX8M
# @DESCRIPTION: Machine configuration for sm2s-imx8mm
# derived from meta-fsl-bsp-releases/meta-bsp/conf/machine/imx8mmevk.conf

MACHINEOVERRIDES =. "imx-boot-container:mx8:mx8m:mx8mm:"

require conf/machine/include/imx-base.inc
require conf/machine/include/imx-preferred-env.inc
require conf/machine/include/tune-cortexa53.inc

IMAGE_FSTYPES += "wic wic.bmap"

MACHINE_FEATURES_append_use-nxp-bsp = " pci wifi bluetooth"
MACHINE_FEATURES_remove_use-nxp-bsp = "nxp8987"

MODULE_DEVICETREE = " \
		msc/imx8mm/msc-sm2s-imx8mm-03N0280I-module.dtb \
		msc/imx8mm/msc-sm2s-imx8mm-03N0840E-module.dtb \
		msc/imx8mm/msc-sm2s-imx8mm-03N0880I-module.dtb \
		msc/imx8mm/msc-sm2s-imx8mm-03N4200I-module.dtb \
		msc/imx8mm/msc-sm2s-imx8mm-03N4210I-module.dtb \
		msc/imx8mm/msc-sm2s-imx8mm-13N0810E-module.dtb \
		msc/imx8mm/msc-sm2s-imx8mm-13N4200I-module.dtb \
		msc/imx8mm/msc-sm2s-imx8mm-13N4800I-module.dtb \
		msc/imx8mm/msc-sm2s-imx8mm-14N0261I-module.dtb \
		msc/imx8mm/msc-sm2s-imx8mm-16N0810E-module.dtb \
		msc/imx8mm/msc-sm2s-imx8mm-24N4200E-module.dtb \
		msc/imx8mm/msc-sf385560-imx8mm-03N0810I-module.dtb \
		msc/imx8mm/asc-sm2s-imx8mm-03N0800E-module.dtb \
		"

OVERLAY_DEVICETREE = " \
		msc/imx8mm/overlay-baseboard-vebo.dtb \
		msc/imx8mm/overlay-baseboard-ep1.dtb \
		msc/imx8mm/overlay-baseboard-ep5.dtb \
		msc/imx8mm/overlay-lvds-ama-070a04.dtb \
		msc/imx8mm/overlay-lvds-ama-101a01.dtb \
		msc/imx8mm/overlay-lvds-ama-121a01.dtb \
		msc/imx8mm/overlay-lvds-auo-p215hvn01.dtb \
		msc/imx8mm/overlay-dsi-rm67191.dtb \
		msc/imx8mm/overlay-dsi-boe-gv101wum-ls0.dtb \
		msc/imx8mm/overlay-spi-flash.dtb \
		msc/imx8mm/overlay-cam-ov5640.dtb \
		"

KERNEL_DEVICETREE_append_use-nxp-bsp = " \
		${MODULE_DEVICETREE} \
		${OVERLAY_DEVICETREE} \
		"

IMX_DEFAULT_BOOTLOADER_use-nxp-bsp = "u-boot-imx"
IMX_DEFAULT_BOOTLOADER_use-mainline-bsp = "u-boot-fslc"

IMX_BOOT_SOC_TARGET = "iMX8MM"
IMX_BOOT_UART_BASE = "0x30860000"

UBOOT_CONFIG ??= "sd"
UBOOT_CONFIG[sd] = "msc_sm2s_imx8mm_config,sdcard"
SPL_BINARY = "spl/u-boot-spl.bin"

ATF_PLATFORM = "imx8mm"
ATF_LOAD_ADDR = "0x920000"

# Extra firmware package name, that is required to build boot container for fslc bsp
IMX_EXTRA_FIRMWARE = "firmware-imx-8m"

# Set u-boot DTB
UBOOT_DTB_NAME = " \
		msc-sm2s-imx8mm.dtb \
		"

# Set DDR FIRMWARE
DDR_FIRMWARE_NAME = " \
		lpddr4_pmu_train_1d_imem.bin \
		lpddr4_pmu_train_1d_dmem.bin \
		lpddr4_pmu_train_2d_imem.bin \
		lpddr4_pmu_train_2d_dmem.bin \
		"

# Set imx-mkimage boot target
IMXBOOT_TARGETS = " \
		flash_board \
		"

# Set Serial console
SERIAL_CONSOLES = "115200;ttymxc0 115200;ttymxc2"

IMAGE_BOOTLOADER = "imx-boot"

LOADADDR = ""
UBOOT_SUFFIX = "bin"
UBOOT_MAKE_TARGET = ""
IMX_BOOT_SEEK = "33"

OPTEE_BIN_EXT = "8mm"
TEE_LOAD_ADDR = "0xbe000000"

IMAGE_INSTALL_append += " \
		imx-boot \
		openssh-sftp openssh-sftp-server \
		test-suite \
		linux-sdio-driver-209a \
		iw wpa-supplicant \
		msc-ldk-verification-wlan \
		\
		python-pyserial python-pybluez \
		python3-spidev python3-pybluez \
		\
		imx-test \
		packagegroup-fsl-tools-benchmark \
		stress dhrystone devmem2 memtester evtest fb-test \
		"

ROOTFS_POSTPROCESS_COMMAND_remove += " remove_boot; "
```

## meta/conf/machine/sm2s-rzg2l.conf
```bitbake
#@TYPE: Machine
#@NAME: smarc-rzg2l machine
#@DESCRIPTION: RZ/G2L SMARC platform

MACHINEOVERRIDES =. "smarc-rzg2l:"

SOC_FAMILY = "r9a07g044l"
require ../../meta-renesas.git/conf/machine/include/rzg2l-common.inc
require ../../meta-renesas.git/conf/machine/include/cip-core.inc

DEFAULTTUNE ?= "cortexa55"

TUNE_CONF ?= "../../meta-renesas.git/conf/machine/include/tune-cortexa55.inc"
require ${TUNE_CONF}

PREFERRED_PROVIDER_virtual/kernel = "linux-renesas"
UBOOT_CONFIG ??= "smarc-rzg2l"
UBOOT_CONFIG[smarc-rzg2l] = "smarc-rzg2l_defconfig"

# flash writer
EXTRA_IMAGEDEPENDS += " flash-writer"

# Supported devicetree
KERNEL_DEVICETREE = " \
	renesas/r9a07g044l2-smarc.dtb \
"

ROOTFS_POSTPROCESS_COMMAND_remove += " remove_boot; "
```

## meta/conf/machine/sm2s-rzg2ul.conf
```bitbake
#@TYPE: Machine
#@NAME: smarc-rzg2ul machine
#@DESCRIPTION: RZ/G2UL SMARC platform

MACHINEOVERRIDES =. "smarc-rzg2ul:"

SOC_FAMILY = "r9a07g043u"
require ../../meta-renesas.git/conf/machine/include/rzg2l-common.inc
require ../../meta-renesas.git/conf/machine/include/cip-core.inc

DEFAULTTUNE ?= "cortexa55"

TUNE_CONF ?= "../../meta-renesas.git/conf/machine/include/tune-cortexa55.inc"
require ${TUNE_CONF}

PREFERRED_PROVIDER_virtual/kernel = "linux-renesas"
UBOOT_CONFIG ??= "smarc-rzg2ul"
UBOOT_CONFIG[smarc-rzg2ul] = "smarc-rzg2ul_defconfig"

# flash writer
EXTRA_IMAGEDEPENDS += " flash-writer"

# Supported devicetree
KERNEL_DEVICETREE = " \
	renesas/r9a07g043u11-smarc.dtb \
"

ROOTFS_POSTPROCESS_COMMAND_remove += " remove_boot; "
```
